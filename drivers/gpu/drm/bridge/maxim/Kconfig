## drivers/gpu/drm/bridge/maxim/Kconfig
```kconfig
config MAXIM_GMSL_DP_SERDES
   bool "Maxim GMSL DP SerDes"
   depends on I2C
   select DRM_DISPLAY_DP_HELPER
   select DRM_DISPLAY_HELPER
   select DRM_KMS_HELPER
   select REGMAP_I2C
   help
    This driver supports the MAXIM DP GMSL SerDes.
    The Intel SOC will send DP output to the Maxim serializer.
    The Maxim serializer will take this DP output,
    and convert it into GMSL video data.
```
